## meta-pi4-xen-lab/conf/layer.conf
```bitbake
BBPATH .= ":${LAYERDIR}"
BBFILES += "${LAYERDIR}/recipes-*/*/*.bb ${LAYERDIR}/recipes-*/*/*.bbappend"
BBFILE_COLLECTIONS += "pi4-xen-lab"
BBFILE_PATTERN_pi4-xen-lab = "^${LAYERDIR}/"
BBFILE_PRIORITY_pi4-xen-lab = "20"
LAYERSERIES_COMPAT_pi4-xen-lab = "scarthgap"
LAYERDEPENDS_pi4-xen-lab = "core raspberrypi virtualization-layer"
PI4_XEN_LAYERDIR := "${LAYERDIR}"
require conf/source-mirrors.inc
require conf/archive-mirrors.inc
INHERIT += "pi4-source-mirrors"
```
